## boards/arm/otterpill/Kconfig.otterpill
```kconfig
# Copyright (c) 2023 Jonas Otto
# SPDX-License-Identifier: Apache-2.0

config BOARD_OTTERPILL
	select SOC_STM32F072X8
```

## boards/arm/otterpill/board.yml
```yaml
board:
  name: otterpill
  vendor: Jana-Marie
  socs:
    # Actually stm32f072x8, but the difference is only in amount of flash, which is specified in the devicetree.
    - name: stm32f072xb
```
